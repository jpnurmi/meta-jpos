## conf/distro/jpos.conf
```bitbake
require conf/distro/poky.conf

DISTRO = "jpos"
DISTRO_NAME = "jpOS"
DISTRO_FEATURES:append = " pam opengl systemd wayland wifi"
DISTRO_FEATURES:remove = " ptest x11"

MAINTAINER = "J-P Nurmi <jpnurmi@gmail.com>"

TARGET_VENDOR = "-jpos"
SDK_VENDOR = "-jpossdk"

INIT_MANAGER = "systemd"

hostname:pn-base-files = "jpos"
```

## conf/layer.conf
```bitbake
# We have a conf and classes directory, add to BBPATH
BBPATH .= ":${LAYERDIR}"

# We have recipes-* directories, add to BBFILES
BBFILES += "${LAYERDIR}/recipes-*/*/*.bb \
            ${LAYERDIR}/recipes-*/*/*.bbappend"

BBFILE_COLLECTIONS += "meta-jpos"
BBFILE_PATTERN_meta-jpos = "^${LAYERDIR}/"
BBFILE_PRIORITY_meta-jpos = "6"

LAYERDEPENDS_meta-jpos = "core"
LAYERSERIES_COMPAT_meta-jpos = "kirkstone"
```
